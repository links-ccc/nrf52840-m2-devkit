## boards/makerdiary/nrf52840_m2/Kconfig.defconfig
```kconfig
# nRF52840 M.2 Developer Kit board configuration

# Copyright (c) 2020 makerdiary
# SPDX-License-Identifier: Apache-2.0

if BOARD_NRF52840_M2

config HW_STACK_PROTECTION
	default ARCH_HAS_STACK_PROTECTION

endif # BOARD_NRF52840_M2
```

## boards/makerdiary/nrf52840_m2/Kconfig.nrf52840_m2
```kconfig
# nRF52840 M.2 Developer Kit board configuration

# Copyright (c) 2020 makerdiary
# SPDX-License-Identifier: Apache-2.0

config BOARD_NRF52840_M2
	select SOC_NRF52840_QIAA
```

## boards/makerdiary/nrf52840_m2/board.yml
```yaml
board:
  name: nrf52840_m2
  full_name: nRF52840 M.2 Developer Kit
  vendor: makerdiary
  socs:
    - name: nrf52840
```

## west.yml
```yaml
# West manifest for the minimal nRF52840 M.2 Developer Kit application.
#
# nRF Connect SDK v3.4.0-rc1 is the Nordic SDK tag whose downstream
# sdk-zephyr tag is Zephyr 4.4.0. Import Zephyr and the Nordic modules through
# the NCS manifest so their Kconfig/CMake dependencies stay version-aligned.

manifest:
  version: "0.13"

  remotes:
    - name: ncs
      url-base: https://github.com/nrfconnect

  defaults:
    remote: ncs

  projects:
    - name: zephyr
      repo-path: sdk-zephyr
      revision: ncs-v3.4.0-rc1
      clone-depth: 1
      import:
        name-allowlist:
          - cmsis
          - cmsis_6
          - hal_nordic
          - hostap
          - picolibc
          - segger
          - tf-psa-crypto
          - zcbor
    - name: nrf
      repo-path: sdk-nrf
      revision: v3.4.0-rc1
      path: nrf
      clone-depth: 1
      west-commands: scripts/west-commands.yml
      import:
        name-allowlist:
          - mbedtls
          - mcuboot
          - nrfxlib
          - oberon-psa-crypto

  self:
    path: nrf52840-m2-devkit
```
